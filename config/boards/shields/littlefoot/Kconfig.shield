## config/boards/shields/littlefoot/Kconfig.shield
```kconfig
# Copyright (c) 2022 The ZMK Contributors
# SPDX-License-Identifier: MIT

config SHIELD_LITTLEFOOT
   def_bool $(shields_list_contains,littlefoot)
```
